## sdkconfig.defaults.esp32c6
```kconfig
CONFIG_IDF_TARGET="esp32c6"

CONFIG_BOARD_TYPE_WAVESHARE_C6_TOUCH_AMOLED_2_06=y
CONFIG_DISABLE_AUTO_LISTEN_AFTER_TTS=y

CONFIG_ESPTOOLPY_FLASHSIZE_16MB=y
CONFIG_PARTITION_TABLE_CUSTOM_FILENAME="partitions/v2/16m_c3.csv"
CONFIG_ESPTOOLPY_FLASHMODE_QIO=y

CONFIG_SR_WN_WN9S_NIHAOXIAOZHI=y

CONFIG_ESP_WIFI_STATIC_RX_BUFFER_NUM=3
CONFIG_ESP_WIFI_DYNAMIC_RX_BUFFER_NUM=6
CONFIG_ESP_WIFI_RX_BA_WIN=3
CONFIG_LWIP_TCPIP_RECVMBOX_SIZE=16
CONFIG_MBEDTLS_DYNAMIC_FREE_CONFIG_DATA=y

CONFIG_ESP_SYSTEM_EVENT_TASK_STACK_SIZE=4096

CONFIG_LV_USE_SNAPSHOT=y

CONFIG_LANGUAGE_RU_RU=y
CONFIG_SKIP_WIFI_SOFTAP_PROVISIONING=y

# HomeBot iOS control channel (BLE GATT with bonding for Wi-Fi credentials)
CONFIG_BT_ENABLED=y
CONFIG_BT_NIMBLE_ENABLED=y
CONFIG_BT_NIMBLE_NVS_PERSIST=y
CONFIG_BT_NIMBLE_SECURITY_ENABLE=y
CONFIG_BT_NIMBLE_SM_SC=y
CONFIG_BT_NIMBLE_MAX_CONNECTIONS=1
CONFIG_BT_NIMBLE_ATT_PREFERRED_MTU=256
```
